## base_external/package/aesdchar/Config.in
```kconfig
config BR2_PACKAGE_AESDCHAR
	bool "aesdchar"
	help
	  Includes the a char driver for a fifo with a circular buffer.
	  Used to understand buildroot external trees and package builds.
```

## base_external/package/ldd/Config.in
```kconfig
config BR2_PACKAGE_LDD
	bool "LDD"
	depends on BR2_LINUX_KERNEL
	help
	  Scull and misc-modules from Ldd repo.
```
